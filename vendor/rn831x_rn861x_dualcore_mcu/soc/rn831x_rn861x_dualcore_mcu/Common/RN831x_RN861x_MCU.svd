# RN831X_RN861X_MCU register map
File version: v0.0.1
RN831X_RN861X_MCU RISC-V Microcontroller based device
CPU: RN831X_RN861X_MCU r1p0, little endian, MPU, no FPU
Registers are 32-bit, read-write, reset 0x0 unless marked. A register's access mark holds for its fields unless they carry their own. Offsets are from the block's base; lines under a group give offsets from that group; [hi:lo] are bit positions; {n}, {i} and the like mark numbered series; 'fields as' and 'values as' point back to an identical list; <NAME> marks a mode.

## Memory map
0x20000000 UART0_CORE0 size 0x44 — UART0 Module core0
0x20004000 UART1_CORE0 size 0x44 — UART1 Module core0
0x20008000 UART2_CORE0 size 0x44 — UART2 Module core0
0x2000C000 UART3_CORE0 size 0x44 — UART3 Module core0
0x20010000 UART4_CORE0 size 0x44 — UART4 Module core0
0x20014000 UART5_CORE0 size 0x44 — UART5 Module core0
0x20018000 UART6_CORE0 size 0x70 — UART6 Module core0
0x2001C000 UART7_CORE0 size 0x70 — UART7 Module core0
0x20020000 LPUART_CORE0 size 0x60 — LPUART Module core0
0x20024000 USART0_CORE0 size 0x60 — USART0 Module core0
0x20028000 USART1_CORE0 size 0x60 — USART1 Module core0
0x2002C000 LSRX_CORE0 size 0x2C — LSRX Module core0
0x20030000 ISO78160_CORE0 size 0x14 — ISO78160 Module core0
0x20034000 ISO78161_CORE0 size 0x14 — ISO78161 Module core0
0x20038000 SPI0_CORE0 size 0x40 — SPI0 Module core0
0x2003C000 SPI1_CORE0 size 0x40 — SPI1 Module core0
0x20040000 SPI2_CORE0 size 0x40 — SPI2 Module core0
0x20044000 SPI3_CORE0 size 0x40 — SPI3 Module core0
0x20050000 I2C0_CORE0 size 0x14 — I2C0 Module core0
0x20054000 I2C1_CORE0 size 0x14 — I2C1 Module core0
0x20058000 CAN_CORE0 size 0x321C — Controller Area Network Module
0x2005C000 IOCNT_CORE0 size 0x74 — IOCNT Module core0
0x20060000 LCD_CORE0 size 0x48 — LCD Module core0
0x20064000 KBI0_CORE0 size 0x54 — KBI0 Module core0
0x20068000 KBI1_CORE0 size 0x54 — KBI1 Module core0
0x2006C000 DSP_CORE0 size 0x100 — DSP Module core0
0x20070000 CRC0_CORE0 size 0x1C — Cyclic Redundancy Check module
0x20078000 M2M_CORE0 size 0x20 — M2M module
0x2007C000 D2F_CORE0 size 0x1EC — D2F Module core0
0x20080000 SYSTEM_CORE0 size 0x810 — SYSTEM Module core0
0x20088000 AOS_CORE0 size 0x9C — AOS Module core0
0x20094000 ADC0_CORE0 size 0x98 — ADC
0x20098000 DAC_CORE0 size 0x28 — DAC
0x2009C000 TC0_CORE0 size 0x50 — A 32-bit timer
0x200A0000 TC1_CORE0 size 0x50
0x200A4000 SIMPTC0_0_CORE0 size 0x10 — simple time counter
0x200A4010 SIMPTC0_1_CORE0 size 0x10
0x200A4020 SIMPTC0_2_CORE0 size 0x10
0x200A4030 SIMPTC0_3_CORE0 size 0x10
0x200A8000 SIMPTC1_0_CORE0 size 0x10
0x200A8010 SIMPTC1_1_CORE0 size 0x10
0x200A8020 SIMPTC1_2_CORE0 size 0x10
0x200A8030 SIMPTC1_3_CORE0 size 0x10
0x200AC000 SIMPTC2_0_CORE0 size 0x10
0x200AC010 SIMPTC2_1_CORE0 size 0x10
0x200AC020 SIMPTC2_2_CORE0 size 0x10
0x200AC030 SIMPTC2_3_CORE0 size 0x10
0x200B0000 SIMPTC3_0_CORE0 size 0x10
0x200B0010 SIMPTC3_1_CORE0 size 0x10
0x200B0020 SIMPTC3_2_CORE0 size 0x10
0x200B0030 SIMPTC3_3_CORE0 size 0x10
0x200B4000 RTC_CORE0 size 0x1E0 — real time clock
0x200B8000 MADC_CORE0 size 0x44 — ADC
0x200B8200 LCSS_VBAT_CORE0 size 0x20 — LCSS_VBAT Module core0
0x200BC000 LVDCMP_CORE0 size 0x20 — LVD and CMP module
0x20100000 WDT_CORE0 size 0x24 — WDT Module core0
0x20104000 DMA00 size 0x210 — General Driect Memory Access module
0x20108000 DMA01 size 0x210 — General Driect Memory Access module
0x2010C000 LCSS_VCC_CORE0 size 0x38 — LCSS_VCC Module core0
0x20114000 CRC1 size 0x1C — Cyclic Redundancy Check module
0x30000000 FLASH_CORE0 size 0x264 — FLASH Module core0
0x30008000 SEA_CORE0 size 0x3E4
0x3000A000 KEYSTORE_CORE0 size 0x78 — KeyStore Module
0x3000C000 MAILBOX_CORE0 size 0x304 — MAILBOX Module core0
0x30014000 AES_CORE0 size 0x54 — AES module
0x30018000 SCU_CORE0 size 0x78 — SCU Module core0
0x3001C000 GIC_CORE0 size 0x23C — GIC Module core0
0xA0000000 UART0_CORE1 size 0x44 — UART0 Module core1
0xA0004000 UART1_CORE1 size 0x44 — UART1 Module core1
0xA0008000 UART2_CORE1 size 0x44 — UART2 Module core1
0xA000C000 UART3_CORE1 size 0x44 — UART3 Module core1
0xA0010000 UART4_CORE1 size 0x44 — UART4 Module core1
0xA0014000 UART5_CORE1 size 0x44 — UART5 Module core1
0xA0018000 UART6_CORE1 size 0x70 — UART6 Module core1
0xA001C000 UART7_CORE1 size 0x70 — UART7 Module core1
0xA0020000 LPUART_CORE1 size 0x60 — LPUART Module core1
0xA0024000 USART0_CORE1 size 0x60 — USART0 Module core1
0xA0028000 USART1_CORE1 size 0x60 — USART1 Module core1
0xA002C000 LSRX_CORE1 size 0x2C — LSRX Module core1
0xA0030000 ISO78160_CORE1 size 0x14 — ISO78160 Module core1
0xA0034000 ISO78161_CORE1 size 0x14 — ISO78161 Module core1
0xA0038000 SPI0_CORE1 size 0x40 — SPI0 Module core1
0xA003C000 SPI1_CORE1 size 0x40 — SPI1 Module core1
0xA0040000 SPI2_CORE1 size 0x40 — SPI2 Module core1
0xA0044000 SPI3_CORE1 size 0x40 — SPI3 Module core1
0xA0050000 I2C0_CORE1 size 0x14 — I2C0 Module core1
0xA0054000 I2C1_CORE1 size 0x14 — I2C1 Module core1
0xA0058000 CAN_CORE1 size 0x321C
0xA005C000 IOCNT_CORE1 size 0x74 — IOCNT Module core1
0xA0060000 LCD_CORE1 size 0x48 — LCD Module core1
0xA0064000 KBI0_CORE1 size 0x54 — KBI0 Module core1
0xA0068000 KBI1_CORE1 size 0x54 — KBI1 Module core1
0xA006C000 DSP_CORE1 size 0x100 — DSP Module core1
0xA0070000 CRC0_CORE1 size 0x1C — Cyclic Redundancy Check module
0xA0078000 M2M_CORE1 size 0x20 — M2M module
0xA007C000 D2F_CORE1 size 0x1EC — D2F Module core1
0xA0080000 SYSTEM_CORE1 size 0x810 — SYSTEM Module core1
0xA0088000 AOS_CORE1 size 0x9C — AOS Module core1
0xA0094000 ADC0_CORE1 size 0x98 — ADC
0xA0098000 DAC_CORE1 size 0x28 — DAC
0xA009C000 TC0_CORE1 size 0x50
0xA00A0000 TC1_CORE1 size 0x50
0xA00A4000 SIMPTC0_0_CORE1 size 0x10
0xA00A4010 SIMPTC0_1_CORE1 size 0x10
0xA00A4020 SIMPTC0_2_CORE1 size 0x10
0xA00A4030 SIMPTC0_3_CORE1 size 0x10
0xA00A8000 SIMPTC1_0_CORE1 size 0x10
0xA00A8010 SIMPTC1_1_CORE1 size 0x10
0xA00A8020 SIMPTC1_2_CORE1 size 0x10
0xA00A8030 SIMPTC1_3_CORE1 size 0x10
0xA00AC000 SIMPTC2_0_CORE1 size 0x10
0xA00AC010 SIMPTC2_1_CORE1 size 0x10
0xA00AC020 SIMPTC2_2_CORE1 size 0x10
0xA00AC030 SIMPTC2_3_CORE1 size 0x10
0xA00B0000 SIMPTC3_0_CORE1 size 0x10
0xA00B0010 SIMPTC3_1_CORE1 size 0x10
0xA00B0020 SIMPTC3_2_CORE1 size 0x10
0xA00B0030 SIMPTC3_3_CORE1 size 0x10
0xA00B4000 RTC_CORE1 size 0x1E0 — real time clock
0xA00B8000 MADC_CORE1 size 0x44 — ADC
0xA00BC000 LVDCMP_CORE1 size 0x20
0xA0100000 WDT_CORE1 size 0x24 — WDT Module core1
0xA0104000 DMA10 size 0x210 — General Driect Memory Access module
0xA0108000 DMA11 size 0x210 — General Driect Memory Access module
0xB0000000 FLASH_CORE1 size 0x264 — FLASH Module core1
0xB0008000 SEA_CORE1 size 0x3E4 — SEA Module
0xB000A000 KEYSTORE_CORE1 size 0x78 — KeyStore Module
0xB000C000 MAILBOX_CORE1 size 0x304 — MAILBOX Module core1
0xB0014000 AES_CORE1 size 0x54 — AES module
0xB0018000 SCU_CORE1 size 0x78 — SCU Module core1
0xB001C000 GIC_CORE1 size 0x23C — GIC Module core1
0xB0080000 GPIOA size 0x78 — GPIOA Module
0xB0080400 GPIOB size 0x78 — GPIOB Module
0xB0080800 GPIOC size 0x78 — GPIOC Module
0xB0080C00 GPIOD size 0x78 — GPIOD Module
0xB0081000 GPIOE size 0x78 — GPIOE Module
0xB0081400 GPIOF size 0x78 — GPIOF Module
0xB0081800 GPIOG size 0x78 — GPIOG Module
0xB0081C00 GPIOH size 0x78 — GPIOH Module
0xB0082C00 GPIOL size 0x78 — GPIOL Module
0xB0084000 HSEM size 0x80 — HSEM Module
0xB0088000 QSPI0 size 0x88 — QSPI0 Module
0xB008C000 QSPI1 size 0x88 — QSPI1 Module
0xB00B8200 LCSS_VBAT_CORE1 size 0x20 — LCSS_VBAT Module core1
0xE0020000 ECLIC size 0x124C — Ehanced Core Local Interrupt Controller
0xE0030000 TIMER size 0xFFF — Timer Unit
