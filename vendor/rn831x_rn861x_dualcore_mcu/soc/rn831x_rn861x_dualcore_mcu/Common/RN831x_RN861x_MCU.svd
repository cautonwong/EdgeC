# RN831X_RN861X_MCU register map
File version: v0.0.1
CPU: RN831X_RN861X_MCU r1p0, little endian, MPU, no FPU
Registers are 32-bit, read-write, reset 0x0 unless marked. A register's access mark holds for its fields unless they carry their own. Offsets are from the block's base; [hi:lo] are bit positions; {n}, {i} and the like mark numbered series; 'fields as' and 'values as' point back to an identical list.

## AOS_CORE0 — AOS Module core0
Base 0x20088000
Same registers: AOS_CORE1 0xA0088000
0x00 SEC_EN access not given — Security peripheral linkage enable register, can only be accessed through address 0x20088000
  [7:0] SEC_EN — Security peripheral linkage enable
0x04 NSEC_EN access not given — Non-security peripheral linkage enable registe, can only be accessed through address 0xA0088000
  [7:0] NSEC_EN — Non-security peripheral linkage enable
0x10 PE_TRGSEL0 — Target peripheral trigger source selection register0, for TC0 External input clock source
  [5:0] TRGSEL — TC0 Trigger source event number. If 0 is written, it means no trigger source event is selected.
    0=NONE (No trigger signal); {v}=UART{v-1}_RX_INPUT (UART{v-1} RX input signal as trigger signal) (v=1..8); 9=LPUART_RX_INPUT (LPUART RX input signal as trigger signal); 10=USART0_RX_INPUT (USART0 RX input signal as trigger signal); 11=USART0_TX_INPUT (USART0 TX input signal as trigger signal); 12=USART1_RX_INPUT (USART1 RX input signal as trigger signal); 13=USART1_TX_INPUT (USART1 TX input signal as trigger signal); 14=ISO78160_IO_INPUT (ISO78160 IO input signal as trigger signal); 15=ISO78160_IN_INPUT (ISO78160 IN input signal as trigger signal); 16=ISO78161_IO_INPUT (ISO78161 IO input signal as trigger signal); 17=ISO78161_IN_INPUT (ISO78161 IN input signal as trigger signal); 18=CAN_RX_INPUT (CAN RX input signal as trigger signal); 19=D2F_CF_OUT0 (D2F CF_OUT0 output signal as trigger signal); 20=D2F_CF_OUT1 (D2F CF_OUT1 output signal as trigger signal); 21=TC1_CH0_POS (TC1 channel 0 positive port output signal as trigger signal); 22=TC1_CH0_NEG (TC1 channel 0 negative port output signal as trigger signal); 23=TC1_CH1_POS (TC1 channel 1 positive port output signal as trigger signal); 24=TC1_CH1_NEG (TC1 channel 1 negative port output signal as trigger signal); 25=VBAT_RTC_OUT (VBAT RTC cycle output signal as trigger signal); {v}=GPIO_TC_PIN{v-26} (GPIO TC PIN{v-26} signal as trigger signal) (v=26..37)
0x14 PE_TRGSEL1 — Target peripheral trigger source selection register1, for TC0 External input events in slave mode
  fields as PE_TRGSEL0
0x18 PE_TRGSEL2 — Target peripheral trigger source selection register2, for TC0 Channel 0 captures external input events
  fields as PE_TRGSEL0
0x1C PE_TRGSEL3 — Target peripheral trigger source selection register3, for TC0 Channel 1 captures external input events
  fields as PE_TRGSEL0
0x20 PE_TRGSEL4 — Target peripheral trigger source selection register4, for TC1 External input clock source
  [5:0] TRGSEL — TC1 Trigger source event number. If 0 is written, it means no trigger source event is selected.
    0=NONE (No trigger signal); {v}=UART{v-1}_RX_INPUT (UART{v-1} RX input signal as trigger signal) (v=1..8); 9=LPUART_RX_INPUT (LPUART RX input signal as trigger signal); 10=USART0_RX_INPUT (USART0 RX input signal as trigger signal); 11=USART0_TX_INPUT (USART0 TX input signal as trigger signal); 12=USART1_RX_INPUT (USART1 RX input signal as trigger signal); 13=USART1_TX_INPUT (USART1 TX input signal as trigger signal); 14=ISO78160_IO_INPUT (ISO78160 IO input signal as trigger signal); 15=ISO78160_IN_INPUT (ISO78160 IN input signal as trigger signal); 16=ISO78161_IO_INPUT (ISO78161 IO input signal as trigger signal); 17=ISO78161_IN_INPUT (ISO78161 IN input signal as trigger signal); 18=CAN_RX_INPUT (CAN RX input signal as trigger signal); 19=D2F_CF_OUT1 (D2F CF_OUT1 output signal as trigger signal); 20=D2F_CF_OUT2 (D2F CF_OUT2 output signal as trigger signal); 21=TC0_CH0_POS (TC0 channel 0 positive port output signal as trigger signal); 22=TC0_CH0_NEG (TC0 channel 0 negative port output signal as trigger signal); 23=TC0_CH1_POS (TC0 channel 1 positive port output signal as trigger signal); 24=TC0_CH1_NEG (TC0 channel 1 negative port output signal as trigger signal); 25=VBAT_RTC_OUT (VBAT RTC cycle output signal as trigger signal); {v}=GPIO_TC_PIN{v-26} (GPIO TC PIN{v-26} signal as trigger signal) (v=26..37)
0x24 PE_TRGSEL5 — Target peripheral trigger source selection register5, for TC1 External input events in slave mode
  fields as PE_TRGSEL4
0x28 PE_TRGSEL6 — Target peripheral trigger source selection register6, for TC1 Channel 0 captures external input events
  fields as PE_TRGSEL4
0x2C PE_TRGSEL7 — Target peripheral trigger source selection register7, for TC1 Channel 1 captures external input events
  fields as PE_TRGSEL4
{0x10+4i} PE_TRGSEL{i} (i=8..11) — Target peripheral trigger source selection register{i}, for SIMPTC0 Hardware trigger channel {i-8} starts counting
  [5:0] TRGSEL — SIMPTC0 channel {i-8} Trigger source event number. If 0 is written, it means no trigger source event is selected.
    0=NONE (No trigger signal); 1=KBI0_CH{i-8}_OUTPUT (KBI0 channel {i-8} output signal as trigger signal); 2=KBI0_CH{i-4}_OUTPUT (KBI0 channel {i-4} output signal as trigger signal); 3=KBI1_CH{i-8}_OUTPUT (KBI1 channel {i-8} output signal as trigger signal); 4=KBI1_CH{i-4}_OUTPUT (KBI1 channel {i-4} output signal as trigger signal)
{0x10+4i} PE_TRGSEL{i} (i=12..15) — Target peripheral trigger source selection register{i}, for SIMPTC1 Hardware trigger channel {i-12} starts counting
  [5:0] TRGSEL — SIMPTC1 channel {i-12} Trigger source event number. If 0 is written, it means no trigger source event is selected.
    0=NONE (No trigger signal); 1=KBI0_CH{i-12}_OUTPUT (KBI0 channel {i-12} output signal as trigger signal); 2=KBI0_CH{i-8}_OUTPUT (KBI0 channel {i-8} output signal as trigger signal); 3=KBI1_CH{i-12}_OUTPUT (KBI1 channel {i-12} output signal as trigger signal); 4=KBI1_CH{i-8}_OUTPUT (KBI1 channel {i-8} output signal as trigger signal)
{0x10+4i} PE_TRGSEL{i} (i=16..19) — Target peripheral trigger source selection register{i}, for SIMPTC2 Hardware trigger channel {i-16} starts counting
  [5:0] TRGSEL — SIMPTC2 channel {i-16} Trigger source event number. If 0 is written, it means no trigger source event is selected.
    values as PE_TRGSEL8.TRGSEL
{0x10+4i} PE_TRGSEL{i} (i=20..23) — Target peripheral trigger source selection register{i}, for SIMPTC3 Hardware trigger channel {i-20} starts counting
  [5:0] TRGSEL — SIMPTC3 channel {i-20} Trigger source event number. If 0 is written, it means no trigger source event is selected.
    values as PE_TRGSEL12.TRGSEL
0x70 PE_TRGSEL24 — Target peripheral trigger source selection register24, for D2F Hardware trigger hardware trigger D2F
  [5:0] TRGSEL — D2F Trigger source event number. If 0 is written, it means no trigger source event is selected.
    0=NONE (No trigger signal); {v}=SIMPTC{v-1}_CH0_OVL (SIMPTC{v-1} channel 0 overflow signal as trigger signal) (v=1..4)
0x74 PE_TRGSEL25 — Target peripheral trigger source selection register25, for IOCNT Channel 0 count source
  [5:0] TRGSEL — IOCNT channel 0 Trigger source event number. If 0 is written, it means no trigger source event is selected.
    0=NONE (No trigger signal); 1=UART6_PF_OUTPUT (UART6 PF output signal as trigger signal); 2=UART6_QF_OUTPUT (UART6 QF output signal as trigger signal); 3=UART6_FPF_OUTPUT (UART6 FPF output signal as trigger signal); 4=UART7_PF_OUTPUT (UART7 PF output signal as trigger signal); 5=UART7_QF_OUTPUT (UART7 QF output signal as trigger signal); 6=UART7_FPF_OUTPUT (UART7 FPF output signal as trigger signal); 7=D2F_CF_OUT0 (D2F CF OUT0 output signal as trigger signal); 8=D2F_CF_OUT1 (D2F CF OUT1 output signal as trigger signal); 9=D2F_CF_OUT2 (D2F CF OUT2 output signal as trigger signal); {v}=KBI0_CH{v-10}_INPUT (KBI0 channel {v-10} input signal as trigger signal) (v=10..13); {v}=KBI1_CH{v-14}_INPUT (KBI1 channel {v-14} input signal as trigger signal) (v=14..17)
0x78 PE_TRGSEL26 — Target peripheral trigger source selection register26, for IOCNT Channel 1 count source
  [5:0] TRGSEL — IOCNT channel 1 Trigger source event number. If 0 is written, it means no trigger source event is selected.
    0=NONE (No trigger signal); 1=UART6_PF_OUTPUT (UART6 PF output signal as trigger signal); 2=UART6_QF_OUTPUT (UART6 QF output signal as trigger signal); 3=UART6_FPF_OUTPUT (UART6 FPF output signal as trigger signal); 4=UART7_PF_OUTPUT (UART7 PF output signal as trigger signal); 5=UART7_QF_OUTPUT (UART7 QF output signal as trigger signal); 6=UART7_FPF_OUTPUT (UART7 FPF output signal as trigger signal); 7=D2F_CF_OUT0 (D2F CF OUT0 output signal as trigger signal); 8=D2F_CF_OUT1 (D2F CF OUT1 output signal as trigger signal); 9=D2F_CF_OUT2 (D2F CF OUT2 output signal as trigger signal); {v}=KBI0_CH{v-6}_INPUT (KBI0 channel {v-6} input signal as trigger signal) (v=10..13); {v}=KBI1_CH{v-10}_INPUT (KBI1 channel {v-10} input signal as trigger signal) (v=14..17)
0x7C PE_TRGSEL27 — Target peripheral trigger source selection register27, for IOCNT Channel 2 count source
  [5:0] TRGSEL — IOCNT channel 2 Trigger source event number. If 0 is written, it means no trigger source event is selected.
    0=NONE (No trigger signal); 1=UART6_PF_OUTPUT (UART6 PF output signal as trigger signal); 2=UART6_QF_OUTPUT (UART6 QF output signal as trigger signal); 3=UART6_FPF_OUTPUT (UART6 FPF output signal as trigger signal); 4=UART7_PF_OUTPUT (UART7 PF output signal as trigger signal); 5=UART7_QF_OUTPUT (UART7 QF output signal as trigger signal); 6=UART7_FPF_OUTPUT (UART7 FPF output signal as trigger signal); 7=D2F_CF_OUT0 (D2F CF OUT0 output signal as trigger signal); 8=D2F_CF_OUT1 (D2F CF OUT1 output signal as trigger signal); 9=D2F_CF_OUT2 (D2F CF OUT2 output signal as trigger signal); {v}=KBI0_CH{v-2}_INPUT (KBI0 channel {v-2} input signal as trigger signal) (v=10..13); {v}=KBI1_CH{v-6}_INPUT (KBI1 channel {v-6} input signal as trigger signal) (v=14..17)
0x80 PE_TRGSEL28 — Target peripheral trigger source selection register28, for IOCNT Channel 3 count source
  [5:0] TRGSEL — IOCNT channel 3 Trigger source event number. If 0 is written, it means no trigger source event is selected.
    0=NONE (No trigger signal); 1=UART6_PF_OUTPUT (UART6 PF output signal as trigger signal); 2=UART6_QF_OUTPUT (UART6 QF output signal as trigger signal); 3=UART6_FPF_OUTPUT (UART6 FPF output signal as trigger signal); 4=UART7_PF_OUTPUT (UART7 PF output signal as trigger signal); 5=UART7_QF_OUTPUT (UART7 QF output signal as trigger signal); 6=UART7_FPF_OUTPUT (UART7 FPF output signal as trigger signal); 7=D2F_CF_OUT0 (D2F CF OUT0 output signal as trigger signal); 8=D2F_CF_OUT1 (D2F CF OUT1 output signal as trigger signal); 9=D2F_CF_OUT2 (D2F CF OUT2 output signal as trigger signal); {v}=KBI0_CH{v+2}_INPUT (KBI0 channel {v+2} input signal as trigger signal) (v=10..13); {v}=KBI1_CH{v-2}_INPUT (KBI1 channel {v-2} input signal as trigger signal) (v=14..17)
0x84 PE_TRGSEL29 — Target peripheral trigger source selection register29, for IOCNT Channel 4 count source
  [5:0] TRGSEL — IOCNT channel 4 Trigger source event number. If 0 is written, it means no trigger source event is selected.
    values as PE_TRGSEL25.TRGSEL
0x88 PE_TRGSEL30 — Target peripheral trigger source selection register30, for RC_CAL Hardware trigger correction
  [5:0] TRGSEL — RC_CAL Trigger source event number. If 0 is written, it means no trigger source event is selected.
    0=NONE (No trigger signal); {v}=KBI0_CH{v-1}_OUTPUT (KBI0 channel {v-1} output signal as trigger signal) (v=1..4); {v}=KBI1_CH{v-5}_OUTPUT (KBI1 channel {v-5} output signal as trigger signal) (v=5..8); {v}=SIMPTC{v-9}_CH0_OVL (SIMPTC{v-9} channel 0 overflow signal as trigger signal) (v=9..12)
0x8C PE_TRGSEL31 — Target peripheral trigger source selection register31, for CAN Timestamp input source
  [5:0] TRGSEL — CAN Trigger source event number. If 0 is written, it means no trigger source event is selected.
    0=NONE (No trigger signal); 1=SIMPTC0_CH2_OVL (SIMPTC0 channel 2 count overflow signal as trigger signal); 2=SIMPTC0_CH3_OVL (SIMPTC0 channel 3 count overflow signal as trigger signal); 3=SIMPTC1_CH2_OVL (SIMPTC1 channel 2 count overflow signal as trigger signal); 4=SIMPTC1_CH3_OVL (SIMPTC1 channel 3 count overflow signal as trigger signal); 5=SIMPTC2_CH2_OVL (SIMPTC2 channel 2 count overflow signal as trigger signal); 6=SIMPTC2_CH3_OVL (SIMPTC2 channel 3 count overflow signal as trigger signal); 7=SIMPTC3_CH2_OVL (SIMPTC3 channel 2 count overflow signal as trigger signal); 8=SIMPTC3_CH3_OVL (SIMPTC3 channel 3 count overflow signal as trigger signal); {v}=GPIO_TC_PIN{v-9} (GPIO TC PIN{v-9} signal as trigger signal) (v=9..20)
0x90 PE_TRGSEL32 — Target peripheral trigger source selection register32, for ADC0 Hardware trigger sequence A starts conversion
  [5:0] TRGSEL — ADC0 Hardware trigger sequence A Trigger source event number. If 0 is written, it means no trigger source event is selected.
    0=NONE (No trigger signal); {v}=KBI0_CH{v-1}_OUTPUT (KBI0 channel {v-1} output signal as trigger signal) (v=1..4); {v}=KBI1_CH{v-5}_OUTPUT (KBI1 channel {v-5} output signal as trigger signal) (v=5..8); {v}=SIMPTC{v-9}_CH0_OVL (SIMPTC{v-9} channel 0 count overflow signal as trigger signal) (v=9..12)
0x94 PE_TRGSEL33 — Target peripheral trigger source selection register33, for ADC0 Hardware trigger sequence B starts conversion
  [5:0] TRGSEL — ADC0 Hardware trigger sequence B Trigger source event number. If 0 is written, it means no trigger source event is selected.
    0=NONE (No trigger signal); {v}=KBI0_CH{v+3}_OUTPUT (KBI0 channel {v+3} output signal as trigger signal) (v=1..4); {v}=KBI1_CH{v-1}_OUTPUT (KBI1 channel {v-1} output signal as trigger signal) (v=5..8); {v}=SIMPTC{v-9}_CH1_OVL (SIMPTC{v-9} channel 1 overflow signal as trigger signal) (v=9..12)
0x98 PE_TRGSEL34 — Target peripheral trigger source selection register34, for DAC Hardware trigger DAC starts conversion
  [5:0] TRGSEL — DAC Trigger source event number. If 0 is written, it means no trigger source event is selected.
    0=NONE (No trigger signal); {v}=KBI0_CH{v+7}_OUTPUT (KBI0 channel {v+7} output signal as trigger signal) (v=1..4); {v}=KBI1_CH{v+3}_OUTPUT (KBI1 channel {v+3} output signal as trigger signal) (v=5..8); {v}=SIMPTC{v-9}_CH2_OVL (SIMPTC{v-9} channel 2 count overflow signal as trigger signal) (v=9..12)
