## Kconfig
```kconfig
mainmenu "EdgeC Industrial SDK Configuration"

config EDGEC_TIER
    string "SDK Tier Level"
    default "ENTERPRISE"
    help
      Basic | Professional | Enterprise. This controls the default feature set.

# Source distributed Kconfigs (Zephyr style)
source "modules/edge_core/Kconfig"
source "modules/edge_infra/Kconfig"
source "foundation/Kconfig"
source "modules/edge_stream/Kconfig"
source "modules/edge_io/Kconfig"
```

## foundation/Kconfig
```kconfig
# foundation/Kconfig

menu "Edge_Protocol (Industrial Stack)"

config EDGEC_PROTO_MODBUS
    bool "Modbus RTU/TCP"
    default y

config EDGEC_PROTO_IEC104
    bool "IEC 60870-5-104"
    default y

config EDGEC_PROTO_SPARKPLUG_B
    bool "MQTT Sparkplug B"
    default y

config EDGEC_PROTO_CCSDS
    bool "CCSDS Space Packet Telemetry"
    default y

config EDGEC_PROTO_DLMS
    bool "DLMS/COSEM (IEC 62056)"
    default y

endmenu

menu "Edge_Algo (Algorithm Math)"

config EDGEC_ALGO_LINALG
    bool "Enable Linear Algebra Module (GSL/Builtin)"
    default y

config EDGEC_ALGO_DSP
    bool "Enable Digital Signal Processing Module"
    default y

config EDGEC_ALGO_AHRS
    bool "Enable AHRS Quaternion Solver"
    depends on EDGEC_ALGO_LINALG
    default y

config EDGEC_ALGO_VIBRA
    bool "Enable Vibra-Sense (RMS, Kurtosis, RUL)"
    depends on EDGEC_ALGO_DSP && EDGEC_ALGO_LINALG
    default y

endmenu
```

## modules/edge_algo/Kconfig
```kconfig
# modules/edge_algo/Kconfig

menu "Edge_Algo (Algorithm Lexicon)"

config EDGEC_ALGO_LINALG
    bool "Enable Linear Algebra Module (GSL/Builtin)"
    default y

config EDGEC_ALGO_DSP
    bool "Enable Digital Signal Processing Module"
    default y

config EDGEC_ALGO_AHRS
    bool "Enable AHRS Quaternion Solver"
    depends on EDGEC_ALGO_LINALG
    default y

config EDGEC_ALGO_VIBRA
    bool "Enable Vibra-Sense (RMS, Kurtosis, RUL)"
    depends on EDGEC_ALGO_DSP && EDGEC_ALGO_LINALG
    default y

endmenu
```

## modules/edge_core/Kconfig
```kconfig
# modules/edge_core/Kconfig

menu "Edge_Core (QtCore Style Foundation)"

config EDGEC_HARDENING
    bool "Enable Security Hardening"
    default y
    help
      Enable stack protection, canary checks, and defensive pointer validation.

config EDGEC_RECURSIVE_MUTEX
    bool "Use Recursive Mutexes for Pipelines"
    default y
    help
      Allows feedback loops in StreamEngine without deadlocking.

config EDGEC_NETBUF_HEADROOM
    int "Default NetBuf Headroom"
    default 64
    help
      Reserved bytes for protocol headers to avoid reallocs.

endmenu
```

## modules/edge_infra/Kconfig
```kconfig
# modules/edge_infra/Kconfig

menu "Edge_Infra (Storage, Bus, and Infrastructure Drivers)"

config EDGE_INFRA_SQLITE
    bool "Enable SQLite Storage Service & Driver"
    default y
    help
      Enables sqlite_service and sqlite_storage_driver in edge_infra.

config EDGE_INFRA_DDS
    bool "Enable CycloneDDS DataHub Backend"
    default y
    help
      Enables CycloneDDS distributed mesh DataHub backend in edge_infra.

config EDGE_INFRA_MQTT
    bool "Enable Northbound MQTT Bridge Backend"
    default y
    help
      Enables MQTT cloud bridge DataHub backend in edge_infra.

endmenu

menu "Edge_Security (Industrial Hardening)"
config EDGEC_SECURITY_DPI
    bool "Enable Deep Packet Inspection Firewall"
    default y
config EDGEC_SECURITY_SIGNED_LOGS
    bool "Enable Cryptographically Signed Audit Logs"
    default y
endmenu
```

## modules/edge_io/Kconfig
```kconfig
# modules/edge_io/Kconfig

menu "Edge_IO (Storage & Connectivity)"

config EDGEC_SNF
    bool "Enable Store-and-Forward (SnF)"
    default y
    help
      Buffering data to SQLite when MQTT is offline.

config EDGEC_PERSISTENCE
    bool "Enable Periodic Persistence"
    default y

endmenu
```

## modules/edge_protocol/Kconfig
```kconfig
# modules/edge_protocol/Kconfig

menu "Edge_Protocol (Industrial Stack)"

config EDGEC_PROTO_MODBUS
    bool "Modbus RTU/TCP"
    default y

config EDGEC_PROTO_IEC104
    bool "IEC 60870-5-104"
    default y

config EDGEC_PROTO_SPARKPLUG_B
    bool "MQTT Sparkplug B"
    default y

config EDGEC_PROTO_CCSDS
    bool "CCSDS Space Packet Telemetry"
    default y

config EDGEC_PROTO_DLMS
    bool "DLMS/COSEM (IEC 62056)"
    default y

endmenu
```

## modules/edge_security/Kconfig
```kconfig
# modules/edge_security/Kconfig

menu "Edge_Security (Industrial Hardening)"

config EDGEC_SECURITY_DPI
    bool "Enable Deep Packet Inspection Firewall"
    default y

config EDGEC_SECURITY_SIGNED_LOGS
    bool "Enable Cryptographically Signed Audit Logs"
    default y

endmenu
```

## modules/edge_stream/Kconfig
```kconfig
# modules/edge_stream/Kconfig

menu "Edge_Stream (Reactive Engine)"

config EDGEC_WASM
    bool "Enable Secure WASM Runtime (WAMR)"
    default y

config EDGEC_WASM_WATCHDOG
    bool "Enable Preemptive WASM Watchdog"
    depends on EDGEC_WASM
    default y

config EDGEC_JS_ENGINE
    bool "Enable QuickJS Embedded Logic"
    default y

endmenu
```

## vendor/rn831x_rn861x_dualcore_mcu/drivers/Kconfig
```kconfig
menuconfig CLOCK_CONTROL_RENERGY
	bool "Renergy RN8xxx Clock Control"
	default y if SOC_FAMILY_RENERGY
	depends on CLOCK_CONTROL
	select RENERGY_USE_FULL_LL_DRIVER

config RESET_RENERGY
	bool "Renergy RN8xxx Reset Control"
	default y if SOC_FAMILY_RENERGY
	depends on RESET

config GPIO_RENERGY
	bool "Renergy RN8xxx GPIO"
	default y if SOC_FAMILY_RENERGY
	depends on GPIO

config UART_RENERGY
	bool "Renergy RN8xxx UART"
	default y if SOC_FAMILY_RENERGY
	depends on SERIAL

config IPM_RENERGY
	bool "Renergy RN8xxx IPM (Mailbox)"
	default y if SOC_FAMILY_RENERGY
	depends on IPM

config ADC_RENERGY
	bool "Renergy RN8xxx ADC"
	default y if SOC_FAMILY_RENERGY
	depends on ADC

config RENERGY_USE_FULL_LL_DRIVER
	bool
	default y if SOC_FAMILY_RENERGY
```

## vendor/rn831x_rn861x_dualcore_mcu/dts/bindings/renergy/renergy,rn8xxx-clock.yaml
```yaml
description: Renergy RN8xxx Clock Control (SCU)
compatible: "renergy,rn8xxx-clock"
include: [clock-control.yaml, base.yaml]
properties:
    reg:
      required: true
    label:
      required: true
    "#clock-cells":
      const: 1
```

## vendor/rn831x_rn861x_dualcore_mcu/dts/bindings/renergy/renergy,rn8xxx-comm-ext.yaml
```yaml
description: Renergy RN8xxx QSPI controller
compatible: "renergy,rn8xxx-qspi"
include: [base.yaml]
properties:
    reg:
      required: true
    interrupts:
      required: true
---
description: Renergy RN8xxx CAN controller
compatible: "renergy,rn8xxx-can"
include: [can-controller.yaml, base.yaml]
properties:
    reg:
      required: true
    interrupts:
      required: true
---
description: Renergy RN8xxx ISO7816 Smart Card interface
compatible: "renergy,rn8xxx-iso7816"
include: [base.yaml]
properties:
    reg:
      required: true
    interrupts:
      required: true
```

## vendor/rn831x_rn861x_dualcore_mcu/dts/bindings/renergy/renergy,rn8xxx-comm.yaml
```yaml
description: Renergy RN8xxx UART/USART controller
compatible: "renergy,rn8xxx-uart"
include: [uart-controller.yaml, base.yaml]
properties:
    reg:
      required: true
    interrupts:
      required: true
---
description: Renergy RN8xxx SPI controller
compatible: "renergy,rn8xxx-spi"
include: [spi-controller.yaml, base.yaml]
properties:
    reg:
      required: true
    interrupts:
      required: true
---
description: Renergy RN8xxx I2C controller
compatible: "renergy,rn8xxx-i2c"
include: [i2c-controller.yaml, base.yaml]
properties:
    reg:
      required: true
    interrupts:
      required: true
```

## vendor/rn831x_rn861x_dualcore_mcu/dts/bindings/renergy/renergy,rn8xxx-ctrl.yaml
```yaml
description: Renergy RN8xxx Timer/Counter (TC)
compatible: "renergy,rn8xxx-tc"
include: [base.yaml]
properties:
    reg:
      required: true
    interrupts:
      required: true
---
description: Renergy RN8xxx PWM (SIMPTC)
compatible: "renergy,rn8xxx-pwm"
include: [base.yaml]
properties:
    reg:
      required: true
    interrupts:
      required: true
    "#pwm-cells":
      const: 2
---
description: Renergy RN8xxx GDMA Controller
compatible: "renergy,rn8xxx-dma"
include: [dma-controller.yaml, base.yaml]
properties:
    reg:
      required: true
    interrupts:
      required: true
    "#dma-cells":
      const: 1
---
description: Renergy RN8xxx Keystore (Secure Key Storage)
compatible: "renergy,rn8xxx-keystore"
include: [base.yaml]
properties:
    reg:
      required: true
    interrupts:
      required: true
```

## vendor/rn831x_rn861x_dualcore_mcu/dts/bindings/renergy/renergy,rn8xxx-dev.yaml
```yaml
description: Renergy RN8xxx GPIO Node
compatible: "renergy,rn8xxx-gpio"
include: [gpio-controller.yaml, base.yaml]
properties:
    reg:
      required: true
    interrupts:
      required: true
    gpio-controller:
      required: true
    "#gpio-cells":
      const: 2
    ngpios:
      required: true
      type: int
---
description: Renergy RN8xxx ADC controller
compatible: "renergy,rn8xxx-adc"
include: [adc-controller.yaml, base.yaml]
properties:
    reg:
      required: true
    interrupts:
      required: true
    "#adc-cells":
      const: 1
---
description: Renergy RN8xxx RTC
compatible: "renergy,rn8xxx-rtc"
include: [base.yaml]
properties:
    reg:
      required: true
    interrupts:
      required: true
---
description: Renergy RN8xxx Watchdog (WDT)
compatible: "renergy,rn8xxx-wdt"
include: [base.yaml]
properties:
    reg:
      required: true
    interrupts:
      required: true
```

## vendor/rn831x_rn861x_dualcore_mcu/dts/bindings/renergy/renergy,rn8xxx-periph.yaml
```yaml
description: Renergy RN8xxx GPIO Node
compatible: "renergy,rn8xxx-gpio"
include: [gpio-controller.yaml, base.yaml]
properties:
    reg:
      required: true
    interrupts:
      required: true
    gpio-controller:
      required: true
    "#gpio-cells":
      const: 2
    ngpios:
      required: true
      type: int
      description: Number of pins on this port (usually 16)
---
description: Renergy RN8xxx SPI Controller
compatible: "renergy,rn8xxx-spi"
include: [spi-controller.yaml, base.yaml]
properties:
    reg:
      required: true
    interrupts:
      required: true
---
description: Renergy RN8xxx I2C Controller
compatible: "renergy,rn8xxx-i2c"
include: [i2c-controller.yaml, base.yaml]
properties:
    reg:
      required: true
    interrupts:
      required: true
---
description: Renergy RN8xxx ADC Controller
compatible: "renergy,rn8xxx-adc"
include: [adc-controller.yaml, base.yaml]
properties:
    reg:
      required: true
    interrupts:
      required: true
    "#adc-cells":
      const: 1
```

## vendor/rn831x_rn861x_dualcore_mcu/dts/bindings/renergy/renergy,rn8xxx-pinctrl.yaml
```yaml
description: Renergy RN8xxx Pin Controller
compatible: "renergy,rn8xxx-pinctrl"
include: [pinctrl-device.yaml, base.yaml]
properties:
    reg:
      required: true
child_binding:
    description: Renergy pin configuration node
    include: [pinctrl-pkt.yaml]
    properties:
        pinmux:
          required: true
          type: int-array
          description: |
            Array of pins and their mux functions.
            Bits 0-7: Pin number
            Bits 8-15: Mux function
```

## vendor/rn831x_rn861x_dualcore_mcu/dts/bindings/renergy/renergy,rn8xxx-sys.yaml
```yaml
description: Renergy RN8xxx System Control Unit (SCU)
compatible: "renergy,rn8xxx-scu"
include: [base.yaml]
properties:
    reg:
      required: true
---
description: Renergy RN8xxx Always-On System (AOS)
compatible: "renergy,rn8xxx-aos"
include: [base.yaml]
properties:
    reg:
      required: true
---
description: Renergy RN8xxx Secure Engine Accelerator (SEA)
compatible: "renergy,rn8xxx-sea"
include: [base.yaml]
properties:
    reg:
      required: true
    interrupts:
      required: true
---
description: Renergy RN8xxx Inter-Processor Mailbox (IPM)
compatible: "renergy,rn8xxx-mailbox"
include: [base.yaml]
properties:
    reg:
      required: true
    interrupts:
      required: true
```

## vendor/rn831x_rn861x_dualcore_mcu/dts/bindings/renergy/renergy,rn8xxx-uart.yaml
```yaml
description: Renergy RN8xxx UART/USART
compatible: "renergy,rn8xxx-uart"
include: [uart-controller.yaml, base.yaml]
properties:
    reg:
      required: true
    interrupts:
      required: true
    label:
      required: true
```

## vendor/rn831x_rn861x_dualcore_mcu/soc/riscv/renergy_rn8xxx/Kconfig.defconfig
```kconfig
if SOC_SERIES_RN8XXX

config SOC_SERIES
	default "renergy_rn8xxx"

config SOC_RENERGY_RN8XXX
	bool
	default y

config SOC
	default "rn8318" if SOC_RN8318

config SYS_CLOCK_HW_CYCLES_PER_SEC
	default 58982400 if SOC_RENERGY_CORE1
	default 29491200 if SOC_RENERGY_CORE0

config NUM_IRQS
	default 147

endif # SOC_SERIES_RN8XXX
```

## vendor/rn831x_rn861x_dualcore_mcu/soc/riscv/renergy_rn8xxx/Kconfig.soc
```kconfig
config SOC_FAMILY_RENERGY
	bool
	select RISCV
	select ATOMIC_OPERATIONS_C

config SOC_SERIES_RN8XXX
	bool
	select SOC_FAMILY_RENERGY

config SOC_RN8318
	bool
	select SOC_SERIES_RN8XXX

if SOC_SERIES_RN8XXX

config SOC_RENERGY_CORE0
	bool "Renergy RN8xxx Core0 (Security)"

config SOC_RENERGY_CORE1
	bool "Renergy RN8xxx Core1 (Application)"

endif # SOC_SERIES_RN8XXX
```
