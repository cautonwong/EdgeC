## CMakeLists.txt
```
# Zephyr Application CMakeLists.txt
cmake_minimum_required(VERSION 3.20)

find_package(Zephyr REQUIRED HINTS $ENV{ZEPHYR_BASE} ${ZEPHYR_BASE})
project(edge_node_zephyr)

# 修正：源文件就在当前目录
target_sources(app PRIVATE 
    main.c
    uv_rtos.c
    edge_osal_zephyr.c
)

target_include_directories(app PRIVATE 
    .
    ../../include
)

target_compile_definitions(app PRIVATE _POSIX_C_SOURCE=200809L)
```

## sample.yaml
```
sample:
  name: EdgeOS Zephyr Node
tests:
  edge_node.main:
    tags: edgeos omnis
    harness: console
    harness_config:
      type: one_line
      regex:
        - "EdgeOS Zephyr Node starting..."
```

## prj.conf
```kconfig
# Kconfig 最佳实践

# 1. 基础系统配置
CONFIG_PRINTK=y
CONFIG_STDOUT_CONSOLE=y

# 2. 日志子系统
CONFIG_LOG=y
CONFIG_LOG_MODE_DEFERRED=y
CONFIG_LOG_DEFAULT_LEVEL=3

# 3. 内存管理与线程
CONFIG_MAIN_STACK_SIZE=4096
CONFIG_HEAP_MEM_POOL_SIZE=16384
CONFIG_DYNAMIC_THREAD=y
CONFIG_THREAD_STACK_INFO=y

# 4. POSIX 与 C 库支持 (EventFD/Poll 所需)
CONFIG_POSIX_API=y
CONFIG_EVENTFD=y

# 5. 调试
CONFIG_DEBUG=y
CONFIG_ASSERT=y
```

## src/main.c
```c
#include <zephyr/kernel.h>
#include <zephyr/logging/log.h>

/* 注册模块日志，类别对齐 EdgeOS 规范 */
LOG_MODULE_REGISTER(edge_node, LOG_LEVEL_INF);

int main(void) {
    LOG_INF("EdgeOS Zephyr Node starting...");
    LOG_INF("Board: %s", CONFIG_BOARD);

    while (1) {
        LOG_DBG("Heartbeat pulse...");

        /* 逻辑占位：未来可以从这里调用 WASM 算子或同步 DataHub */

        k_sleep(K_MSEC(1000));
    }

    return 0;
}
```
